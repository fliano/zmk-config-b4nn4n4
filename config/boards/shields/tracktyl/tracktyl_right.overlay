// tracktyl_right.overlay

#include "tracktyl.dtsi"

&default_transform { // The matrix transform for this board is 6 columns over because the left half is 6 columns wide according to the matrix.
    col-offset = <5>;
};

&kscan0 {
    col-gpios
        = <&pro_micro 9 GPIO_ACTIVE_HIGH> // col1 in the schematic
        , <&pro_micro 8 GPIO_ACTIVE_HIGH> // col2 in the schematic
        , <&pro_micro 4 GPIO_ACTIVE_HIGH> // col3 in the schematic
        , <&pro_micro 6 GPIO_ACTIVE_HIGH> // col4 in the schematic
        , <&pro_micro 5 GPIO_ACTIVE_HIGH> // col5 in the schematic
        ;
};

/* Enable spi2 bus and the trackball, and define their pins */
&spi0 {
  status = "okay";
  sck-pin = <8>;
  mosi-pin = <17>;
  miso-pin = <17>; // same as mosi (3-wire spi)
  cs-gpios = <&gpio0 20 GPIO_ACTIVE_LOW>;
};

&trackball {
  status = "okay";
  irq-gpios = <&gpio0 6 (GPIO_ACTIVE_LOW | GPIO_PULL_UP)>;
};