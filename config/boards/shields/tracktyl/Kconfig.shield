## config/boards/shields/tracktyl/Kconfig.shield
```kconfig
config SHIELD_MY_BOARD_LEFT
    def_bool $(shields_list_contains,tracktyl_left)

config SHIELD_MY_BOARD_RIGHT
    def_bool $(shields_list_contains,tacktyl_right)
```

## config/west.yml
```yaml
manifest:
  remotes:
    - name: zmkfirmware
      url-base: https://github.com/fliano
  projects:
    - name: zmk
      remote: zmkfirmware
      revision: pmw3610
      import: app/west.yml
  self:
    path: config
```
